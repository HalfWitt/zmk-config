## config/west.yml
```yaml
manifest:
  remotes:
    - name: zmkfirmware
      url-base: https://github.com/zmkfirmware
    - name: caksoylar
      url-base: https://github.com/caksoylar
    - name: infused-kim
      url-base: https://github.com/infused-kim
  projects:
    - name: zmk
      remote: caksoylar
      revision: split-encoder
      import: app/west.yml
      remote: infused-kim
      revision: my-changes/oled-ext-pwr
      import: app/west.yml
  self:
    path: config
```
